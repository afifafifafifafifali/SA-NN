// SA-NN Interference Header Generated by SA-NN ( SPELLING MISTAKE AINT BEING REPAIRED)
#include <stdint.h>
#include <avr/pgmspace.h>
#ifndef SA_NN_MODEL_H
#define SA_NN_MODEL_H

#define L0_IN 60
#define L0_OUT 20
#define L1_IN 20
#define L1_OUT 10
#define L2_IN 10
#define L2_OUT 2

const int8_t SIGN_L0[20][60] PROGMEM = {
  {-1, 1, 1, 1, 1, 1, 1, 1, 1, -1, 1, 1, 1,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 1, -1},
  {1, 1, 1, 1, 1, 1, 1, 1, 1, 1, 1, 1, 1,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 1, 1},
  {-1, 1, 1, 1, -1, 1, 1, 1, 1, -1, 1, 1, 1,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 -1, 1},
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  {1, -1, -1, -1, -1, -1, -1, -1, -1, 1, -1, -1, -1,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 1, 1}
};
const int8_t SIGN_L1[10][20] PROGMEM = {
  {-1, -1, 1, 1, -1, 1, 1, -1, 1, -1, 1, 1, 1, -1, -1, 1, 1, 1, 1, 1},
  {1, 1, 1, -1, 1, 1, 1, 1, 1, 1, -1, 1, -1, 1, 1, 1, -1, 1, 1, -1},
  {1, 1, 1, -1, 1, -1, 1, 1, 1, 1, -1, 1, -1, 1, -1, -1, -1, 1, 1, -1},
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  {1, 1, -1, -1, 1, -1, 1, -1, 1, 1, -1, -1, -1, 1, -1, -1, 1, 1, 1, -1}
};
const int8_t SIGN_L2[2][10] PROGMEM = {
  {1, -1, -1, 1, 1, 1, -1, 1, 1, -1},
  {1, 1, 1, 1, -1, -1, 1, -1, -1, 1}
};

const uint8_t SHIFT_L0[20][60] PROGMEM = {
  {0, 0, 0, 0, 0, 0, 0, 0, 0, 0, 0, 0, 0,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 0, 0},
  {0, 0, 0, 0, 0, 0, 0, 0, 0, 0, 0, 0, 0,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 0, 0},
  {0, 0, 0, 0, 0, 0, 0, 0, 0, 0, 0, 0, 0,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 0, 0},
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  {0, 0, 0, 0, 0, 0, 0, 0, 0, 0, 0, 0, 0,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 0, 0}
};
const uint8_t SHIFT_L1[10][20] PROGMEM = {
  {0, 0, 0, 0, 0, 0, 0, 0, 0, 0, 0, 0, 0, 0, 0, 0, 0, 0, 0, 0},
  {0, 0, 0, 0, 0, 0, 0, 0, 0, 0, 0, 0, 0, 0, 0, 0, 0, 0, 0, 0},
  {0, 0, 0, 0, 0, 0, 0, 0, 0, 0, 0, 0, 0, 0, 0, 0, 0, 0, 0, 0},
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  {0, 0, 0, 0, 0, 0, 0, 0, 0, 0, 0, 0, 0, 0, 0, 0, 0, 0, 0, 0}
};
const uint8_t SHIFT_L2[2][10] PROGMEM = {
  {0, 0, 0, 0, 0, 0, 0, 0, 0, 0},
  {0, 0, 0, 0, 0, 0, 0, 0, 0, 0}
};

const int16_t BIAS_L0[20] PROGMEM = { 0, 0, 0, 0, 0, 0, 0, 0, 0, 0, 0, 0, 0, 0, 0, 0, 0, 0, 0, 0 };
const int16_t BIAS_L1[10] PROGMEM = { 0, 0, 0, 0, 0, 0, 0, 0, 0, 0 };
const int16_t BIAS_L2[2] PROGMEM = { 0, 0 };

#define MAX_VAL 32764

int16_t relu(int16_t x){return x>0?x:0;}

const int VOCAB_SIZE=60;
const char VOCAB_WORD_0[] PROGMEM = "good";
const char VOCAB_WORD_1[] PROGMEM = "great";
const char VOCAB_WORD_2[] PROGMEM = "excellent";
const char VOCAB_WORD_3[] PROGMEM = "amazing";
const char VOCAB_WORD_4[] PROGMEM = "fantastic";
const char VOCAB_WORD_5[] PROGMEM = "awesome";
const char VOCAB_WORD_6[] PROGMEM = "wonderful";
const char VOCAB_WORD_7[] PROGMEM = "perfect";
const char VOCAB_WORD_8[] PROGMEM = "love";
const char VOCAB_WORD_9[] PROGMEM = "best";
const char VOCAB_WORD_10[] PROGMEM = "beautiful";
const char VOCAB_WORD_11[] PROGMEM = "brilliant";
const char VOCAB_WORD_12[] PROGMEM = "outstanding";
const char VOCAB_WORD_13[] PROGMEM = "superb";
const char VOCAB_WORD_14[] PROGMEM = "marvelous";
const char VOCAB_WORD_15[] PROGMEM = "incredible";
const char VOCAB_WORD_16[] PROGMEM = "phenomenal";
const char VOCAB_WORD_17[] PROGMEM = "terrific";
const char VOCAB_WORD_18[] PROGMEM = "splendid";
const char VOCAB_WORD_19[] PROGMEM = "fabulous";
const char VOCAB_WORD_20[] PROGMEM = "bad";
const char VOCAB_WORD_21[] PROGMEM = "terrible";
const char VOCAB_WORD_22[] PROGMEM = "awful";
const char VOCAB_WORD_23[] PROGMEM = "horrible";
const char VOCAB_WORD_24[] PROGMEM = "worst";
const char VOCAB_WORD_25[] PROGMEM = "hate";
const char VOCAB_WORD_26[] PROGMEM = "disgusting";
const char VOCAB_WORD_27[] PROGMEM = "annoying";
const char VOCAB_WORD_28[] PROGMEM = "boring";
const char VOCAB_WORD_29[] PROGMEM = "sad";
const char VOCAB_WORD_30[] PROGMEM = "disappointing";
const char VOCAB_WORD_31[] PROGMEM = "mediocre";
const char VOCAB_WORD_32[] PROGMEM = "poor";
const char VOCAB_WORD_33[] PROGMEM = "weak";
const char VOCAB_WORD_34[] PROGMEM = "dull";
const char VOCAB_WORD_35[] PROGMEM = "frustrating";
const char VOCAB_WORD_36[] PROGMEM = "unpleasant";
const char VOCAB_WORD_37[] PROGMEM = "regrettable";
const char VOCAB_WORD_38[] PROGMEM = "abysmal";
const char VOCAB_WORD_39[] PROGMEM = "pathetic";
const char VOCAB_WORD_40[] PROGMEM = "movie";
const char VOCAB_WORD_41[] PROGMEM = "film";
const char VOCAB_WORD_42[] PROGMEM = "story";
const char VOCAB_WORD_43[] PROGMEM = "plot";
const char VOCAB_WORD_44[] PROGMEM = "acting";
const char VOCAB_WORD_45[] PROGMEM = "performance";
const char VOCAB_WORD_46[] PROGMEM = "character";
const char VOCAB_WORD_47[] PROGMEM = "characters";
const char VOCAB_WORD_48[] PROGMEM = "scene";
const char VOCAB_WORD_49[] PROGMEM = "scenes";
const char VOCAB_WORD_50[] PROGMEM = "very";
const char VOCAB_WORD_51[] PROGMEM = "really";
const char VOCAB_WORD_52[] PROGMEM = "quite";
const char VOCAB_WORD_53[] PROGMEM = "extremely";
const char VOCAB_WORD_54[] PROGMEM = "so";
const char VOCAB_WORD_55[] PROGMEM = "not";
const char VOCAB_WORD_56[] PROGMEM = "but";
const char VOCAB_WORD_57[] PROGMEM = "and";
const char VOCAB_WORD_58[] PROGMEM = "the";
const char VOCAB_WORD_59[] PROGMEM = "this";

int string_equals(const char* s1,const char* s2_pgm,int max_len){
    for(int i=0;i<max_len;i++){
        char s2_char = pgm_read_byte(&(s2_pgm[i]));
        if(s1[i]!=s2_char) return 0;
        if(s1[i]=='\0' && s2_char=='\0') return 1;
        if(s1[i]=='\0' || s2_char=='\0') return 0;
    }
    char s2_last = pgm_read_byte(&(s2_pgm[max_len]));
    return (s1[max_len]=='\0' && s2_last=='\0');
}

int find_vocab_index(const char* word,int word_len){
  if(string_equals(word,VOCAB_WORD_0,word_len)) return 0;
  if(string_equals(word,VOCAB_WORD_1,word_len)) return 1;
  if(string_equals(word,VOCAB_WORD_2,word_len)) return 2;
  if(string_equals(word,VOCAB_WORD_3,word_len)) return 3;
  if(string_equals(word,VOCAB_WORD_4,word_len)) return 4;
  if(string_equals(word,VOCAB_WORD_5,word_len)) return 5;
  if(string_equals(word,VOCAB_WORD_6,word_len)) return 6;
  if(string_equals(word,VOCAB_WORD_7,word_len)) return 7;
  if(string_equals(word,VOCAB_WORD_8,word_len)) return 8;
  if(string_equals(word,VOCAB_WORD_9,word_len)) return 9;
  if(string_equals(word,VOCAB_WORD_10,word_len)) return 10;
  if(string_equals(word,VOCAB_WORD_11,word_len)) return 11;
  if(string_equals(word,VOCAB_WORD_12,word_len)) return 12;
  if(string_equals(word,VOCAB_WORD_13,word_len)) return 13;
  if(string_equals(word,VOCAB_WORD_14,word_len)) return 14;
  if(string_equals(word,VOCAB_WORD_15,word_len)) return 15;
  if(string_equals(word,VOCAB_WORD_16,word_len)) return 16;
  if(string_equals(word,VOCAB_WORD_17,word_len)) return 17;
  if(string_equals(word,VOCAB_WORD_18,word_len)) return 18;
  if(string_equals(word,VOCAB_WORD_19,word_len)) return 19;
  if(string_equals(word,VOCAB_WORD_20,word_len)) return 20;
  if(string_equals(word,VOCAB_WORD_21,word_len)) return 21;
  if(string_equals(word,VOCAB_WORD_22,word_len)) return 22;
  if(string_equals(word,VOCAB_WORD_23,word_len)) return 23;
  if(string_equals(word,VOCAB_WORD_24,word_len)) return 24;
  if(string_equals(word,VOCAB_WORD_25,word_len)) return 25;
  if(string_equals(word,VOCAB_WORD_26,word_len)) return 26;
  if(string_equals(word,VOCAB_WORD_27,word_len)) return 27;
  if(string_equals(word,VOCAB_WORD_28,word_len)) return 28;
  if(string_equals(word,VOCAB_WORD_29,word_len)) return 29;
  if(string_equals(word,VOCAB_WORD_30,word_len)) return 30;
  if(string_equals(word,VOCAB_WORD_31,word_len)) return 31;
  if(string_equals(word,VOCAB_WORD_32,word_len)) return 32;
  if(string_equals(word,VOCAB_WORD_33,word_len)) return 33;
  if(string_equals(word,VOCAB_WORD_34,word_len)) return 34;
  if(string_equals(word,VOCAB_WORD_35,word_len)) return 35;
  if(string_equals(word,VOCAB_WORD_36,word_len)) return 36;
  if(string_equals(word,VOCAB_WORD_37,word_len)) return 37;
  if(string_equals(word,VOCAB_WORD_38,word_len)) return 38;
  if(string_equals(word,VOCAB_WORD_39,word_len)) return 39;
  if(string_equals(word,VOCAB_WORD_40,word_len)) return 40;
  if(string_equals(word,VOCAB_WORD_41,word_len)) return 41;
  if(string_equals(word,VOCAB_WORD_42,word_len)) return 42;
  if(string_equals(word,VOCAB_WORD_43,word_len)) return 43;
  if(string_equals(word,VOCAB_WORD_44,word_len)) return 44;
  if(string_equals(word,VOCAB_WORD_45,word_len)) return 45;
  if(string_equals(word,VOCAB_WORD_46,word_len)) return 46;
  if(string_equals(word,VOCAB_WORD_47,word_len)) return 47;
  if(string_equals(word,VOCAB_WORD_48,word_len)) return 48;
  if(string_equals(word,VOCAB_WORD_49,word_len)) return 49;
  if(string_equals(word,VOCAB_WORD_50,word_len)) return 50;
  if(string_equals(word,VOCAB_WORD_51,word_len)) return 51;
  if(string_equals(word,VOCAB_WORD_52,word_len)) return 52;
  if(string_equals(word,VOCAB_WORD_53,word_len)) return 53;
  if(string_equals(word,VOCAB_WORD_54,word_len)) return 54;
  if(string_equals(word,VOCAB_WORD_55,word_len)) return 55;
  if(string_equals(word,VOCAB_WORD_56,word_len)) return 56;
  if(string_equals(word,VOCAB_WORD_57,word_len)) return 57;
  if(string_equals(word,VOCAB_WORD_58,word_len)) return 58;
  if(string_equals(word,VOCAB_WORD_59,word_len)) return 59;
  return -1;
}

void string_to_features(const char* text,int8_t* features,int max_len){
    for(int i=0;i<max_len && i<VOCAB_SIZE;i++) features[i]=0;
    int text_len=0; while(text[text_len]!='\0') text_len++;
    int start=0;
    for(int i=0;i<=text_len;i++){
        if(text[i]==' ' || text[i]=='\0'){
            if(i>start){
                char token[50]; int token_len=i-start;
                if(token_len>=50) token_len=49;
                for(int k=0;k<token_len;k++) token[k]=text[start+k];
                token[token_len]='\0';
                for(int k=0;k<token_len;k++)
                    if(token[k]>='A' && token[k]<='Z') token[k]+=('a'-'A');
                int vid=find_vocab_index(token,token_len);
                if(vid>=0 && vid<max_len) features[vid]=1;
            }
            start=i+1;
        }
    }
}

void interfere_text(const char* text,int16_t* output){int8_t processed_input[VOCAB_SIZE];string_to_features(text,processed_input,VOCAB_SIZE);
  int16_t layer_0[L0_OUT];
  int16_t layer_1[L1_OUT];
  int16_t layer_2[L2_OUT];
  for(int j=0;j<L0_OUT;j++){
    int32_t sum=pgm_read_word(&(BIAS_L0[j]));
    for(int k=0;k<L0_IN;k++){
      int16_t val=processed_input[k];
      sum+=(int8_t)pgm_read_byte(&(SIGN_L0[j][k]))*(val<<(uint8_t)pgm_read_byte(&(SHIFT_L0[j][k])));
    }
    sum=relu((int16_t)sum);
    if(sum<0)sum=0;else if(sum>MAX_VAL)sum=MAX_VAL;
    layer_0[j]=(int16_t)sum;
  }
  for(int j=0;j<L1_OUT;j++){
    int32_t sum=pgm_read_word(&(BIAS_L1[j]));
    for(int k=0;k<L1_IN;k++){
      int16_t val=layer_0[k];
      sum+=(int8_t)pgm_read_byte(&(SIGN_L1[j][k]))*(val<<(uint8_t)pgm_read_byte(&(SHIFT_L1[j][k])));
    }
    sum=relu((int16_t)sum);
    if(sum<0)sum=0;else if(sum>MAX_VAL)sum=MAX_VAL;
    layer_1[j]=(int16_t)sum;
  }
  for(int j=0;j<L2_OUT;j++){
    int32_t sum=pgm_read_word(&(BIAS_L2[j]));
    for(int k=0;k<L2_IN;k++){
      int16_t val=layer_1[k];
      sum+=(int8_t)pgm_read_byte(&(SIGN_L2[j][k]))*(val<<(uint8_t)pgm_read_byte(&(SHIFT_L2[j][k])));
    }
    if(sum<0)sum=0;else if(sum>MAX_VAL)sum=MAX_VAL;
    output[j]=(int16_t)sum;
  }
}
#endif // SA_NN_MODEL_H